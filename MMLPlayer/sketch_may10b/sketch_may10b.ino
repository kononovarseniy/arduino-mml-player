#include "Music.h"

const char music[] PROGMEM = {0x74, 0x31, 0x33, 0x33, 0x6C, 0x31, 0x36, 0x67, 0x3C, 0x67, 0x67, 0x67, 0x67, 0x67, 0x67, 0x67,
                              0x67, 0x67, 0x67, 0x67, 0x3E, 0x66, 0x3C, 0x67, 0x67, 0x67, 0x67, 0x67, 0x67, 0x67, 0x67, 0x67,
                              0x67, 0x67, 0x3E, 0x64, 0x2B, 0x3C, 0x67, 0x67, 0x67, 0x67, 0x67, 0x67, 0x67, 0x67, 0x67, 0x67,
                              0x67, 0x3E, 0x64, 0x3C, 0x67, 0x67, 0x67, 0x67, 0x67, 0x67, 0x67, 0x67, 0x31, 0x3E, 0x3E, 0x64,
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                              0x64, 0x3C, 0x61, 0x2B, 0x61, 0x2B, 0x61, 0x2B, 0x61, 0x2B, 0x67, 0x67, 0x67, 0x67, 0x3C, 0x67,
                              0x31
                             };

void delayMcs(unsigned long long t) {
  unsigned long long beg = micros();
  while (micros() - beg < t);
}

void beep(int frequency, int duration) {
  duration = duration < 0 ? 0 : duration;
  unsigned long long t = frequency > 0 ? 1000000ULL / frequency : 0;
  unsigned long long beg = millis();
  while (millis() - beg < duration) {
    if (frequency > 0) {
      PORTD &= B11100111;
      PORTD |= B11101111;
      delayMcs(t);
      PORTD &= B11100111;
      PORTD |= B11110111;
      delayMcs(t);
    }
  }
}

char getChar(const char *str) {
  return pgm_read_byte_near(str);
}

int ReadModifier(const char *str, int *res) {
  switch (getChar(str)) {
    case '+':
    case '#':
      *res = SHARP;
      return 1;
    case '-':
    case '.':
      *res = FLAT;
      return 1;
    default:
      *res = NORMAL;
      return 0;
  }
}

int ReadNumber(const char *str, int *res) {
  const char *ptr = str;
  int d = getChar(ptr) - '0';
  int val = 0;
  while (d >= 0 && d < 10) {
    val = val * 10 + d;
    d = getChar(++ptr) - '0';
  }
  *res = val;
  return ptr - str;
}


void setup() {
  pinMode(14, INPUT);
  pinMode(3, OUTPUT);
  pinMode(4, OUTPUT);

  pinMode(6, OUTPUT);
  pinMode(7, OUTPUT);
  digitalWrite(6, HIGH);
  digitalWrite(7, LOW);

  Serial.begin(115200);
}

int beatPeriod = 631;
int defaultLength = 4;
int currentOctave = 4;

uint8_t buf[1024];
void loop() {
  beatPeriod = 631;
  defaultLength = 4;
  currentOctave = 4;
  int len = strlen_P(music);
  int i = 0;
  while (i < len) {
    char ch = toupper(getChar(music + i++));
    //Serial.println(ch);
    if (isNoteName(ch)) {
      int modifier = 0;
      int noteLength = 0;
      i += ReadModifier(music + i, &modifier);
      i += ReadNumber(music + i, &noteLength);
      if (noteLength == 0) noteLength = defaultLength;
      int freq = round(getNoteFrequency(ch, modifier, currentOctave));
      int duration = beatPeriod * 4 / noteLength;
      Serial.print(ch);
      switch (modifier) {
        case FLAT: Serial.print("-"); break;
        case NORMAL: Serial.print(""); break;
        case SHARP: Serial.print("#"); break;
      }
      Serial.print("\t1/");
      Serial.print(noteLength);
      Serial.print(" ");
      Serial.println(freq);
      beep(freq, duration);
    }
    else if (ch == 'P' || ch == 'R') {
      int noteLength = 0;
      i += ReadNumber(music + i, &noteLength);
      if (noteLength == 0) noteLength = defaultLength;
      int duration = beatPeriod * 4 / noteLength;
      Serial.print("PAUSE 1/");
      Serial.println(noteLength);
      beep(0, duration);
    }
    else if (ch == 'O') {
      i += ReadNumber(music + i, &currentOctave);
      Serial.print("Octave = ");
      Serial.println(currentOctave);
    }
    else if (ch == 'L') {
      i += ReadNumber(music + i, &defaultLength);
      Serial.print("Default length = 1/");
      Serial.println(defaultLength);
    }
    else if (ch == 'T') {
      int beatsPerMinute;
      i += ReadNumber(music + i, &beatsPerMinute);
      Serial.print("Tempo = ");
      Serial.print(beatsPerMinute);
      Serial.println(" beats per minute");
      beatPeriod = 60000 / beatsPerMinute;
    }
    else if (ch == '>') {
      currentOctave++;
      Serial.print("Octave up (");
      Serial.print(currentOctave);
      Serial.println(")");
    }
    else if (ch == '<') {
      currentOctave--;
      Serial.print("Octave down (");
      Serial.print(currentOctave);
      Serial.println(")");
    }
  }
}
